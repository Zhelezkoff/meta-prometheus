## conf/layer.conf
```bitbake
# We have a conf and classes directory, add to BBPATH
BBPATH .= ":${LAYERDIR}"

# We have recipes-* directories, add to BBFILES
BBFILES += "${LAYERDIR}/recipes-*/*/*.bb \
            ${LAYERDIR}/recipes-*/*/*.bbappend"

BBFILE_COLLECTIONS += "meta-prometheus"
BBFILE_PATTERN_meta-prometheus = "^${LAYERDIR}/"
BBFILE_PRIORITY_meta-prometheus = "6"

LAYERDEPENDS_meta-prometheus = "core"
LAYERSERIES_COMPAT_meta-prometheus = "walnascar"
```
